#include <Adafruit_NeoPixel.h>
#include <WiFiClientSecure.h>
#include <WiFi.h>
#include <PubSubClient.h>

//ESP32C6 has the LED on GPIO_8
constexpr uint8_t LED_PIN = 8;

// Only one LED (not addressable LED chain)
constexpr uint8_t NUM_LEDS = 1;

// Init RGB helper
Adafruit_NeoPixel rgbLed(NUM_LEDS, LED_PIN);

// Predefined RGB colours
uint8_t COLOR_OFF[]  = {0, 0, 0};
uint8_t COLOR_WHITE[] = {255, 255, 255};

// Flag to track the state of the LED
bool led_on = false;

// MQTT related data
PubSubClient mqttClient;
// MQTT Server IP or Domain
const char *mqtt_server = "127.0.0.1";
// MQTT Port, 1883 is default port for unencrypted traffic while 8883 is the default for encrypted
const uint16_t mqtt_port = 8883;
// Username and password for MQTT broker (optional, depending on the MQTT broker setting)
const char *mqtt_username = "user";
const char *mqtt_password = "user123";
// MQTT client name, only really relevant for MQTT logging
const char *mqtt_client_name = "esp32-c6-lamp";
// MQTT topic to send messages in
const char *mqtt_topic = "home/living_room/lamp/command";

// WiFi related data
WiFiClientSecure wifiClient;
const char *wifi_ssid = "ssid";
const char *wifi_pwd = "password";

// CA cert that was generated and self-signed on the server
const char* server_ca_cert = R"EOF(
-----BEGIN CERTIFICATE-----
MIIDETCCAfmgAwIBAgIUUgf0eV6oHupIIXQGVyCVjYJkxqYwDQYJKoZIhvcNAQEL
BQAwGDEWMBQGA1UEAwwNVHJ1c3RlZENBLm5ldDAeFw0yNTAxMzAyMDI3NDVaFw0y
NjAxMzAyMDI3NDVaMBgxFjAUBgNVBAMMDVRydXN0ZWRDQS5uZXQwggEiMA0GCSqG
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J9xARxultAtPx6O8GhV4/UA1tlonXoS1G8GH9ZrcphW+sxIBwf9Nwavsp6KZZ6fE
+ykcpXRaYmLmeEhbunpyME1VSV+r
-----END CERTIFICATE-----
)EOF";

// The client CA certificate and private key is also generated by the server but is used by the client for verification
const char* client_ca_cert = R"EOF(
-----BEGIN CERTIFICATE-----
MIICszCCAZsCFBlnbd1uQ2s1isLGJIasMALJdyywMA0GCSqGSIb3DQEBCwUAMBgx
FjAUBgNVBAMMDVRydXN0ZWRDQS5uZXQwHhcNMjUwMTMwMjEwODI0WhcNMjYwMTMw
MjEwODI0WjAUMRIwEAYDVQQDDAlsb2NhbGhvc3QwggEiMA0GCSqGSIb3DQEBAQUA
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3XI3p+gYhrgBqYBgXme7xVowfSCKmPckaKbVtLvNPh8gmT/djhkc4IgKA2sCDjtr
Z5wvz5lJFld8/5Ib8OBkaDYhbXyssSw=
-----END CERTIFICATE-----
)EOF";

const char* client_priv_key= R"EOF(
-----BEGIN PRIVATE KEY-----
MIIEvQIBADANBgkqhkiG9w0BAQEFAASCBKcwggSjAgEAAoIBAQC/kPD5LxsJXtxr
3BLDXwd29ilH0n1pi7XRK/dTp2zgkmDFTGDEaqEo61Z49UzkzZ9dWXP2nyhE2Ujw
Ve99wPotQn3Aweyfxok4Wql3yPeqe849IRn6eS9hNCuVRIjbC8C10WX49eY5YpWV
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vjVAlBcCyISUFKlIGBhB55614Ig03gWV73/v/KJsPXgqUWZ/PV+KfLtKJMBuGvKp
UPkMiMD+IBVN0mrX2aJJ8NM=
-----END PRIVATE KEY-----
)EOF";

// This function sets up WiFi related settings (connection, certificates)
void setupWiFi() {
  WiFi.mode(WIFI_STA);
  WiFi.begin(wifi_ssid, wifi_pwd);
  Serial.print("Connecting to WiFi...");
  while (WiFi.status() != WL_CONNECTED) {
    Serial.print(".");
    delay(1000);
  }
  Serial.println("Connected to WiFi");
  wifiClient.setCACert(server_ca_cert);
  wifiClient.setCertificate(client_ca_cert);
  wifiClient.setPrivateKey(client_priv_key);
}

// This function connects to MQTT server
void setupMQTT() {
  mqttClient.setClient(wifiClient);
  mqttClient.setServer(mqtt_server, mqtt_port);
  mqttClient.setCallback(message_callback);
  
  if (mqttClient.connect(mqtt_client_name, mqtt_username, mqtt_password)) {
    Serial.println("Connected to MQTT");
    subscribeToTopic();
  }
  else
  {
    Serial.println("Failed to connect to MQTT server");
    Serial.printf("State: %d", mqttClient.state());
  }
}

// This function readies the LED functionality, it is not required for functionality
void setupLED() {
  rgbLed.begin(); 
  rgbLed.show(); 
}

// Method to change the colour of the LED depending on the colour array
void setColor(uint8_t color[]) {
    rgbLed.setPixelColor(0, color[0], color[1], color[2]);
    rgbLed.show();
}

// This function is called on every new message received.
// We read the message and if it matches "on" or "off", we adjust the colour of the LED light
void message_callback(char* topic, byte* payload, unsigned int length) {
  Serial.printf("Message arrived [%s]", topic);
  String message;
  for (int i=0;i<length;i++) 
  {
  message += (char)payload[i];
  }
  if (message == "on")
  {
    setColor(COLOR_WHITE);
    led_on = true;
  }
  else if (message == "off") 
  {
    setColor(COLOR_OFF);
    led_on = false;
  }
  else 
  {
    Serial.print("Invalid command, ignoring...\n");
  }
}

// This function handles the subscription to the defined topic
void subscribeToTopic()
{
   if (mqttClient.connected())
   {
    mqttClient.subscribe(mqtt_topic);
    Serial.print("Subscribed to topic\n");
   }
   else 
   {
    Serial.print("Not connected to MQTT broker\n");
   }
}

// In case we disconnected from the broker, this function tries to reestablish a connection
void reconnectToBroker() 
{
  while (!mqttClient.connected()) 
  {
    if (mqttClient.connect(mqtt_client_name))
    {
      subscribeToTopic();
    }
  }
}

void setup() {

  Serial.begin(115200);

  setupWiFi();

  setupMQTT();

  setupLED();
}

void loop() {
  if(!mqttClient.connected())
  {
    reconnectToBroker();
  }
  mqttClient.loop();
}
